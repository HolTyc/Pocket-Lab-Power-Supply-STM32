/* Minimal SSD1306 128x32 OLED driver over I2C1 (HAL). */

#include "ssd1306.h"

#include <string.h>

#include "app_config.h"

extern I2C_HandleTypeDef hi2c1;

#define SSD1306_I2C_TIMEOUT_MS  50u
#define SSD1306_CTRL_CMD        0x00
#define SSD1306_CTRL_DATA       0x40

static uint8_t framebuffer[OLED_WIDTH * OLED_HEIGHT / 8];

/* Classic 5x7 ASCII font, characters 0x20..0x7E, column-major,
 * LSB = top pixel. Public domain (originally from the Adafruit GLCD font). */
static const uint8_t font5x7[] = {
  0x00, 0x00, 0x00, 0x00, 0x00, /* ' ' */
  0x00, 0x00, 0x5F, 0x00, 0x00, /* '!' */
  0x00, 0x07, 0x00, 0x07, 0x00, /* '"' */
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  0x08, 0x08, 0x2A, 0x1C, 0x08, /* '~' */
};

static bool ssd1306_write(uint8_t ctrl, const uint8_t *data, uint16_t len)
{
  return HAL_I2C_Mem_Write(&hi2c1, OLED_I2C_ADDR << 1, ctrl,
                           I2C_MEMADD_SIZE_8BIT, (uint8_t *)data, len,
                           SSD1306_I2C_TIMEOUT_MS) == HAL_OK;
}

static bool ssd1306_cmds(const uint8_t *cmds, uint16_t len)
{
  return ssd1306_write(SSD1306_CTRL_CMD, cmds, len);
}

bool ssd1306_init(void)
{
  static const uint8_t init_seq[] = {
    0xAE,        /* display off */
    0xD5, 0x80,  /* clock divide ratio / oscillator */
    0xA8, OLED_HEIGHT - 1, /* multiplex ratio */
    0xD3, 0x00,  /* display offset */
    0x40,        /* start line 0 */
    0x8D, 0x14,  /* charge pump on */
    0x20, 0x00,  /* horizontal addressing mode */
    0xA1,        /* segment remap (flip X) */
    0xC8,        /* COM scan direction (flip Y) */
    0xDA, 0x02,  /* COM pins config for 128x32 */
    0x81, 0x8F,  /* contrast */
    0xD9, 0xF1,  /* pre-charge period */
    0xDB, 0x40,  /* VCOMH deselect level */
    0xA4,        /* resume from RAM content */
    0xA6,        /* normal (non-inverted) */
    0xAF,        /* display on */
  };

  ssd1306_clear();

  if (!ssd1306_cmds(init_seq, sizeof(init_seq))) {
    return false;
  }

  return ssd1306_update();
}

void ssd1306_display_off(void)
{
  static const uint8_t off_cmd[] = { 0xAE };
  ssd1306_cmds(off_cmd, sizeof(off_cmd));
}

void ssd1306_clear(void)
{
  memset(framebuffer, 0, sizeof(framebuffer));
}

static void ssd1306_set_pixel(int x, int y)
{
  if (x < 0 || x >= OLED_WIDTH || y < 0 || y >= OLED_HEIGHT) {
    return;
  }

  framebuffer[x + (y / 8) * OLED_WIDTH] |= (uint8_t)(1u << (y % 8));
}

void ssd1306_fill_rect(int x, int y, int w, int h, bool on)
{
  for (int px = x; px < x + w; px++) {
    for (int py = y; py < y + h; py++) {
      if (px < 0 || px >= OLED_WIDTH || py < 0 || py >= OLED_HEIGHT) {
        continue;
      }

      uint8_t mask = (uint8_t)(1u << (py % 8));

      if (on) {
        framebuffer[px + (py / 8) * OLED_WIDTH] |= mask;
      } else {
        framebuffer[px + (py / 8) * OLED_WIDTH] &= (uint8_t)~mask;
      }
    }
  }
}

static void ssd1306_draw_char(int x, int y, char c, int scale)
{
  if (c < 0x20 || c > 0x7E) {
    c = '?';
  }

  const uint8_t *glyph = &font5x7[(c - 0x20) * 5];

  for (int col = 0; col < 5; col++) {
    uint8_t bits = glyph[col];

    for (int row = 0; row < 7; row++) {
      if (!(bits & (1u << row))) {
        continue;
      }

      for (int sx = 0; sx < scale; sx++) {
        for (int sy = 0; sy < scale; sy++) {
          ssd1306_set_pixel(x + col * scale + sx, y + row * scale + sy);
        }
      }
    }
  }
}

void ssd1306_draw_text(int x, int y, const char *str, int scale)
{
  for (; *str != '\0'; str++) {
    ssd1306_draw_char(x, y, *str, scale);
    x += 6 * scale; /* 5 px glyph + 1 px spacing */
  }
}

int ssd1306_text_width(const char *str, int scale)
{
  int len = (int)strlen(str);

  if (len == 0) {
    return 0;
  }

  return len * 6 * scale - scale; /* no trailing spacing column */
}

bool ssd1306_update(void)
{
  static const uint8_t window[] = {
    0x21, 0, OLED_WIDTH - 1,           /* column range */
    0x22, 0, OLED_HEIGHT / 8 - 1,      /* page range */
  };

  if (!ssd1306_cmds(window, sizeof(window))) {
    return false;
  }

  return ssd1306_write(SSD1306_CTRL_DATA, framebuffer, sizeof(framebuffer));
}
